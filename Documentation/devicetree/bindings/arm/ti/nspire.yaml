## Documentation/devicetree/bindings/arm/ti/nspire.yaml
```yaml
# SPDX-License-Identifier: GPL-2.0
%YAML 1.2
---
$id: http://devicetree.org/schemas/arm/ti/nspire.yaml#
$schema: http://devicetree.org/meta-schemas/core.yaml#

title: TI-NSPIRE calculators

maintainers:
  - Daniel Tang <dt.tangr@gmail.com>
  - Fabian Vogt <fabian@ritter-vogt.de>

properties:
  $nodename:
    const: '/'
  compatible:
    items:
      - enum:
          # CX II models
          - ti,nspire-cx2
          # CX models
          - ti,nspire-cx
          # Touchpad models
          - ti,nspire-tp
          # Clickpad models
          - ti,nspire-clp

additionalProperties: true

...
```

## Documentation/devicetree/bindings/clock/ti,nspire-cx2-clock.yaml
```yaml
# SPDX-License-Identifier: (GPL-2.0-only OR BSD-2-Clause)
%YAML 1.2
---
$id: http://devicetree.org/schemas/clock/ti,nspire-cx2-clock.yaml#
$schema: http://devicetree.org/meta-schemas/core.yaml#

title: Binding for the clock source in the TI Nspire CX II PMU

maintainers:
  - Fabian Vogt <fabian@ritter-vogt.de>

description: |
  The PMU is the base clock source of the SOC in the TI Nspire CX II and allows
  flexible configuration of the frequency over a wide range.

properties:
  compatible:
    const: ti,nspire-cx2-clock

  reg:
    maxItems: 1

  '#clock-cells':
    const: 0

required:
  - compatible
  - reg
  - '#clock-cells'

additionalProperties: false

examples:
  - |
    base-clock@90140000 {
        compatible = "ti,nspire-cx2-clock";
        reg = <0x90140000 0x1000>;
        #clock-cells = <0>;
    };
```

## Documentation/devicetree/bindings/usb/faraday,fotg210-udc.yaml
```yaml
# SPDX-License-Identifier: (GPL-2.0 OR BSD-2-Clause)
%YAML 1.2
---
$id: http://devicetree.org/schemas/usb/faraday,fotg210-udc.yaml#
$schema: http://devicetree.org/meta-schemas/core.yaml#

title: Faraday FOTG210 USB Peripheral Controller

maintainers:
  - Fabian Vogt <fabian@ritter-vogt.de>

description: |
  USB 2.0 Device Controller with an MMIO interface.
  Only bulk transfers are supported.

properties:
  compatible:
    enum:
      - faraday,fotg210-udc
      - faraday,fotg210-nspire-udc

  reg:
    maxItems: 1

  interrupts:
    maxItems: 1

required:
  - compatible
  - reg
  - interrupts

additionalProperties: false

examples:
  - |
    udc@0 {
        compatible = "faraday,fotg210-udc";
        reg = <0xB0000000 0x1000>;
        interrupts = <8>;
    };
```
